## techpack/audio/Kconfig
```kconfig
menu "Techpack audio options"

config PINCTRL_WCD
        tristate "PINCTRL_WCD"
config AUDIO_EXT_CLK
        tristate "AUDIO_EXT_CLK"
config SND_SOC_WCD9XXX_V2
        tristate "SND_SOC_WCD9XXX_V2"
config SND_SOC_WCD_MBHC
        tristate "SND_SOC_WCD_MBHC"
config SND_SOC_WSA881X
        tristate "SND_SOC_WSA881X"
config SND_SOC_WCD_DSP_MGR
        tristate "SND_SOC_WCD_DSP_MGR"
config SND_SOC_WCD_SPI
        tristate "SND_SOC_WCD_SPI"
config SND_SOC_WCD934X
        tristate "SND_SOC_WCD934X"
config SND_SOC_WCD934X_MBHC
        tristate "SND_SOC_WCD934X_MBHC"
config SND_SOC_WCD934X_DSD
        tristate "SND_SOC_WCD934X_DSD"
config WCD9XXX_CODEC_CORE
        tristate "WCD9XXX_CODEC_CORE"
config SND_SOC_WCD_CPE
        tristate "SND_SOC_WCD_CPE"
config SND_SOC_CPE
        tristate "SND_SOC_CPE"
config SND_SOC_WCD9335
        tristate "SND_SOC_WCD9335"
config MSM_CDC_PINCTRL
        tristate "MSM_CDC_PINCTRL"
config MSM_QDSP6V2_CODECS
        tristate "MSM_QDSP6V2_CODECS"
config MSM_ULTRASOUND
        tristate "MSM_ULTRASOUND"
config MSM_QDSP6_APRV2_RPMSG
        tristate "MSM_QDSP6_APRV2_RPMSG"
config MSM_ADSP_LOADER
        tristate "MSM_ADSP_LOADER"
config REGMAP_SWR
        tristate "REGMAP_SWR"
config MSM_QDSP6_SSR
        tristate "MSM_QDSP6_SSR"
config MSM_QDSP6_PDR
        tristate "MSM_QDSP6_PDR"
config MSM_QDSP6_NOTIFIER
        tristate "MSM_QDSP6_NOTIFIER"
config SND_SOC_MSM_HOSTLESS_PCM
        tristate "SND_SOC_MSM_HOSTLESS_PCM"
config SND_SOC_MSM_QDSP6V2_INTF
        tristate "SND_SOC_MSM_QDSP6V2_INTF"
config SND_SOC_SM6150
        tristate "SND_SOC_SM6150"
config MSM_GLINK_SPI_XPRT
        tristate "MSM_GLINK_SPI_XPRT"
config WCD_DSP_GLINK
        tristate "WCD_DSP_GLINK"
config SOUNDWIRE
        tristate "SOUNDWIRE"
config SOUNDWIRE_MSTR_CTRL
        tristate "SOUNDWIRE_MSTR_CTRL"
config SND_SOC_QDSP6V2
        tristate "SND_SOC_QDSP6V2"
config SND_SOC_WCD_MBHC_ADC
        tristate "SND_SOC_WCD_MBHC_ADC"
config SND_SOC_WCD_MBHC_LEGACY
        tristate "SND_SOC_WCD_MBHC_LEGACY"
config QTI_PP
        tristate "QTI_PP"
config SND_HWDEP_ROUTING
        tristate "SND_HWDEP_ROUTING"
config DTS_EAGLE
        tristate "DTS_EAGLE"
config DOLBY_DS2
        tristate "DOLBY_DS2"
config DOLBY_LICENSE
        tristate "DOLBY_LICENSE"
config DTS_SRS_TM
        tristate "DTS_SRS_TM"
config SND_SOC_MSM_STUB
        tristate "SND_SOC_MSM_STUB"
config MSM_AVTIMER
        tristate "MSM_AVTIMER"
config AVTIMER_LEGACY
        tristate "AVTIMER_LEGACY"
config SND_SOC_MSM_HDMI_CODEC_RX
        tristate "SND_SOC_MSM_HDMI_CODEC_RX"
config SND_SOC_BOLERO
        tristate "SND_SOC_BOLERO"
config WSA_MACRO
        tristate "WSA_MACRO"
config VA_MACRO
        tristate "VA_MACRO"
config RX_MACRO
        tristate "RX_MACRO"
config TX_MACRO
        tristate "TX_MACRO"
config SND_SOC_WCD_IRQ
        tristate "SND_SOC_WCD_IRQ"
config SND_SOC_WCD937X
        tristate "SND_SOC_WCD937X"
config SND_SOC_WCD937X_SLAVE
        tristate "SND_SOC_WCD937X_SLAVE"
config SND_EVENT
        tristate "SND_EVENT"
config SND_SOC_MAX98937
        tristate "SND_SOC_MAX98937"
config SND_SOC_TAS2562
        tristate "SND_SOC_TAS2562"
endmenu	
```
